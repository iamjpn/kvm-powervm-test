## kvm-on-powervm/configs/kvm_l1_defconfig
```kconfig
BR2_powerpc64le=y
BR2_KERNEL_HEADERS_6_0=y
BR2_GCC_VERSION_12_X=y
BR2_TOOLCHAIN_BUILDROOT_CXX=y
BR2_CCACHE=y
BR2_TARGET_GENERIC_HOSTNAME="kvm-on-powervm"
BR2_TARGET_GENERIC_ISSUE="'Just because I write crap code, doesn't mean I'm a bad person.' - mikey"
BR2_INIT_SYSTEMD=y
BR2_SYSTEM_BIN_SH_BASH=y
BR2_SYSTEM_DEFAULT_PATH="/bin:/sbin:/usr/bin:/usr/sbin"
BR2_ENABLE_LOCALE_WHITELIST="C en_US en_AU"
BR2_ROOTFS_POST_FAKEROOT_SCRIPT="$(BR2_EXTERNAL)/scripts/pre-image.sh"
BR2_ROOTFS_POST_IMAGE_SCRIPT="$(BR2_EXTERNAL)/scripts/post-image.sh"
BR2_LINUX_KERNEL=y
BR2_LINUX_KERNEL_DEFCONFIG="pseries_le"
BR2_LINUX_KERNEL_CONFIG_FRAGMENT_FILES="$(BR2_EXTERNAL)/configs/linux/l1.config"
BR2_LINUX_KERNEL_VMLINUX=y
BR2_LINUX_KERNEL_ZSTD=y
BR2_LINUX_KERNEL_INSTALL_TARGET=y
BR2_PACKAGE_XZ=y
BR2_PACKAGE_ZSTD=y
BR2_PACKAGE_KEXEC_LITE=y
BR2_PACKAGE_KVM_UNIT_TESTS=y
BR2_PACKAGE_STRACE=y
BR2_PACKAGE_BINUTILS=y
BR2_PACKAGE_BINUTILS_TARGET=y
BR2_PACKAGE_DIFFUTILS=y
BR2_PACKAGE_FINDUTILS=y
BR2_PACKAGE_SED=y
BR2_PACKAGE_TREE=y
BR2_PACKAGE_EXPECT=y
BR2_PACKAGE_LIBGCRYPT=y
BR2_PACKAGE_SLIRP=y
BR2_PACKAGE_LIBCAP_NG=y
BR2_PACKAGE_BASH_COMPLETION=y
BR2_PACKAGE_FILE=y
BR2_PACKAGE_SCREEN=y
BR2_PACKAGE_TIME=y
BR2_PACKAGE_WHICH=y
BR2_PACKAGE_HTOP=y
BR2_PACKAGE_POWERPC_UTILS=y
BR2_PACKAGE_SYSTEMD_INITRD=y
BR2_PACKAGE_LESS=y
BR2_PACKAGE_NANO=y
BR2_PACKAGE_VIM=y
BR2_TARGET_ROOTFS_CPIO=y
BR2_PACKAGE_HOST_PYTHON3=y
BR2_PACKAGE_HOST_QEMU=y
BR2_PACKAGE_HOST_QEMU_SYSTEM_MODE=y
BR2_PACKAGE_HOST_QEMU_VIRTFS=y
BR2_PACKAGE_QEMU_L1=y
BR2_PACKAGE_QEMU_L1_CUSTOM_TARGETS="ppc64-softmmu"
BR2_PACKAGE_QEMU_L1_FDT=y
```
